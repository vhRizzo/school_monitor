## main/Kconfig.projbuild
```kconfig
menu "WiFi Set"

    config ESP_WIFI_SSID
        string "WiFi SSID"
        default "default_ssid"
        help
            SSID (network name) for the example to connect to.

    config ESP_WIFI_PASSWORD
        string "WiFi Password"
        default "default_pass"
        help
            WiFi password (WPA or WPA2) for the example to use.

    config ESP_MAXIMUM_RETRY
        int "Maximum retry"
        default 5
        help
            Set the Maximum retry to avoid station reconnecting to the AP unlimited when the AP is really inexistent.

endmenu

menu "MQTT Set"

    config BROKER_URL
        string "Broker URL"
        default "mqtt://default.mqtt.broker"
        help
            URL of the broker to connect to

endmenu
```
